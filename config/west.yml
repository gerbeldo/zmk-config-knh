## config/west.yml
```yaml
manifest:
  remotes:
    - name: zmkfirmware
      url-base: https://github.com/zmkfirmware
    - name: urob
      url-base: https://github.com/urob
    - name: caksoylar
      url-base: https://github.com/caksoylar
    - name: gerbeldo
      url-base: https://github.com/gerbeldo

  projects:
    - name: zmk
      remote: zmkfirmware
      import: app/west.yml
      revision: main

    - name: zmk-auto-layer
      remote: urob
      revision: main

    - name: zmk-tri-state
      remote: urob
      revision: main

    - name: flake-zmk-module
      remote: gerbeldo
      revision: main

  self:
    path: config
```
