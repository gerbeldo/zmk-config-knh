// ZMK Core Includes
#include <behaviors.dtsi>
#include <behaviors/num_word.dtsi> // requires https://github.com/urob/zmk-auto-layer module
#include <dt-bindings/zmk/keys.h>
#include <dt-bindings/zmk/bt.h>
#include <dt-bindings/zmk/outputs.h>

// Layers
#define L1 0
#define L2 1
#define Fn 2

// Meh key
#define MEH LS(LC(LALT))

// Hyper Key: ⇧ ⌥ ^ ⌘ (Shift + Alt + Control + Command)
#define LEFT_HYPER             LS(LA(LC(LGUI)))
#define LHYP                   LEFT_HYPER
#define LH                     LEFT_HYPER

// Behaviors Constants
#define TAPPING_TERM_MS 200
#define QUICK_TAP_MS 175
#define REQUIRE_PRIOR_IDLE_MS 150

// Combos Constants
#define COMBO_TERM_DEFAULT 30
#define COMBO_QUICK_TAP_MS 100

#include "behaviors.dtsi"
#include "macros.dtsi"
#include "combos.dtsi"

// Alpha layer
#include "L1_qwerty.dtsi"

// Other layers
#include "L2.dtsi"
#include "Fn.dtsi"
